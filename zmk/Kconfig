## zmk/Kconfig
```kconfig
rsource "drivers/usb/Kconfig"
rsource "drivers/bluetooth/Kconfig"
rsource "drivers/sensor/Kconfig"
rsource "drivers/watchdog/Kconfig"
rsource "drivers/led/Kconfig"

config BOOT_DIAG
	bool "Boot diagnostic (.noinit SRAM buffer for SWS debug)"
	default n
	help
	  Records boot stage codes to a .noinit SRAM buffer that can be read
	  via SWS/BDT even when USB is not working.

config BOOT_DIAG_GPIO
	bool "Boot diagnostic GPIO heartbeat (PD7)"
	default y
	depends on BOOT_DIAG
	help
	  Toggle PD7 at each boot stage for logic analyzer visibility.

config FLASH_MGMT
	bool "Raw flash management via mcumgr"
	default n
	depends on MCUMGR && FLASH
	help
	  Adds a custom mcumgr group (ID 64) with raw flash erase/write/read
	  commands. Used to restore original firmware via USB without SWS
	  hardware.
```

## zmk/boards/crush80/Kconfig.board
```kconfig
# SPDX-License-Identifier: Apache-2.0

config BOARD_CRUSH80
	select SOC_SERIES_RISCV32_TELINK_B91
```

## zmk/drivers/led/Kconfig
```kconfig
config AW20216S
	bool "AW20216S LED matrix driver"
	depends on SPI
	help
	  Driver for the AWINIC AW20216S 216-channel SPI LED matrix controller.
	  Used on the Wobkey Crush 80 for per-key RGB lighting.

if AW20216S

config AW20216S_INIT_PRIORITY
	int "Init priority"
	default 90

config AW20216S_LOG_LEVEL
	int "Log level"
	default 3

config AW20216S_CHANNEL_SCAN
	bool "AW20216S channel scan mode (bring-up only)"
	help
	  Replaces normal RGB with a sequential scanner that lights each
	  (chip, sw_row, cs_col) for 400ms and prints the address over serial.
	  Use during bring-up to build the led_sw/led_cs channel map tables.
	  Must be disabled for production builds.

endif # AW20216S
```

## zmk/dts/bindings/led/wobkey,aw20216s.yaml
```yaml
# Copyright (c) 2025
# SPDX-License-Identifier: Apache-2.0

description: |
  AW20216S 216-channel SPI LED matrix controller (Wobkey Crush 80).

compatible: "wobkey,aw20216s"

include: [spi-device.yaml]

properties:
  num-leds:
    type: int
    required: true
    description: Number of logical LEDs driven by this controller.

  global-current:
    type: int
    default: 32
    description: |
      Global current control register value (0x00-0xFF).
      Default 32 (0x20) = ~12% of max current — safe starting value.
      Increase for brighter LEDs; max 0xFF = 100%.

  enable-gpios:
    type: phandle-array
    description: |
      Optional GPIO to enable LED power (active-high MOSFET gate).
      On the Crush 80, a GPIO drives a MOSFET that powers the AW20216S.
      UNKNOWN pin — must be extracted from firmware LED init function.
```
