## zmk/Kconfig
```kconfig
rsource "drivers/usb/Kconfig"
rsource "drivers/bluetooth/Kconfig"
rsource "drivers/sensor/Kconfig"
rsource "drivers/watchdog/Kconfig"

config BOOT_DIAG
	bool "Boot diagnostic (.noinit SRAM buffer for SWS debug)"
	default n
	help
	  Records boot stage codes to a .noinit SRAM buffer that can be read
	  via SWS/BDT even when USB is not working.

config BOOT_DIAG_GPIO
	bool "Boot diagnostic GPIO heartbeat (PD7)"
	default y
	depends on BOOT_DIAG
	help
	  Toggle PD7 at each boot stage for logic analyzer visibility.

config FLASH_MGMT
	bool "Raw flash management via mcumgr"
	default n
	depends on MCUMGR && FLASH
	help
	  Adds a custom mcumgr group (ID 64) with raw flash erase/write/read
	  commands. Used to restore original firmware via USB without SWS
	  hardware.

config CRUSH80_LAYER_RGB
	bool "Per-layer and per-modifier backlight colour (single colour, superseded by the per-key engine)"
	default y
	depends on !CRUSH80_RGB_ENGINE
	depends on CRUSH80_RGB && ZMK_RGB_UNDERGLOW && DT_HAS_CRUSH80_LAYER_RGB_ENABLED
	help
	  Follows the active layer and held modifiers with the backlight colour. Colours come
	  from the crush80,layer-rgb node in the keymap. Needs the Solid effect.

config CRUSH80_RGB_ENGINE
	bool "Per-key backlight engine"
	default y
	depends on CRUSH80_RGB && !ZMK_RGB_UNDERGLOW && DT_HAS_CRUSH80_RGB_SCHEME_ENABLED
	help
	  Colours each key by what it does on the active layer and lights the side bar and logo in
	  the layer colour. Replaces ZMK's single-colour underglow, which must be off.

config CRUSH80_RGB_BRT_MAX
	int "Backlight maximum brightness (percent of full)"
	default 25
	range 1 100
	depends on CRUSH80_RGB_ENGINE

config CRUSH80_RGB_BUDGET
	int "Frame current budget (sum of all colour channels, 0-117810)"
	default 30000
	depends on CRUSH80_RGB_ENGINE
	help
	  A frame whose channel sum is larger is scaled down. 30000 is about 25 percent of all LEDs
	  at full white, the cap the board has run with since the first RGB test.

config CRUSH80_OS
	bool "macOS / Windows layer selection with saved choice"
	default y

config CRUSH80_RGB
	bool "Crush 80 Reboot Pro LED strip"
	depends on DT_HAS_TELINK_B91_SPI_LED_STRIP_ENABLED && GPIO && LED_STRIP
	select DYNAMIC_INTERRUPTS
	help
	  Drives the 154 WS2812-compatible LEDs via PSPI and DMA on PB7.
	  Enable via conf/rgb.conf and conf/rgb.overlay.

config CRUSH80_MANUAL_CONFIRM
	bool "Leave new images unconfirmed until the host confirms them"
	default y
	depends on BOOTLOADER_MCUBOOT
	help
	  Trial boot. A freshly swapped-in image stays unconfirmed, so any
	  cold boot (unplug and replug) restores the previous image. The
	  host tool confirms after it has checked the board. Disable only
	  for builds that must self-confirm with no host present.
```

## zmk/dts/bindings/behaviors/crush80,behavior-os.yaml
```yaml
description: Choose the host OS layer set (action 0 = macOS, 1 = Windows, 2 = toggle). The choice is saved.

compatible: "crush80,behavior-os"

include: zero_param.yaml

properties:
  action:
    type: int
    required: true
```

## zmk/dts/bindings/behaviors/crush80,behavior-rgb.yaml
```yaml
description: Crush 80 backlight control (action 0 = on/off, 1 = brighter, 2 = dimmer, 3 = battery gauge while held)

compatible: "crush80,behavior-rgb"

include: zero_param.yaml

properties:
  action:
    type: int
    required: true
```

## zmk/dts/bindings/misc/crush80,layer-rgb.yaml
```yaml
description: Per-layer and per-modifier backlight colour for the Crush 80 RGB build

compatible: "crush80,layer-rgb"

include: base.yaml

properties:
  layer-hues:
    type: array
    required: true
    description: Hue (0-359) for each keymap layer, in layer index order. The highest active layer wins.
  layer-sats:
    type: array
    required: true
    description: Saturation (0-100) for each layer, same order as layer-hues.
  layer-on:
    type: array
    required: true
    description: 1 = show the layer colour, 0 = backlight off while this layer is the highest active one (all LEDs black, LED power cut). Same order as layer-hues.
  mod-hues:
    type: array
    required: true
    description: Hue for a held modifier, in the order Ctrl, Shift, Alt, Gui (left and right share a colour). A held modifier overrides the layer colour.
  mod-sats:
    type: array
    required: true
    description: Saturation for a held modifier, same order as mod-hues.
```

## zmk/dts/bindings/misc/crush80,os-config.yaml
```yaml
description: Which keymap layer is the Windows marker layer (the keymap sets win-layer; 255 = no OS switching)

compatible: "crush80,os-config"

include: base.yaml

properties:
  win-layer:
    type: int
    default: 255
```

## zmk/dts/bindings/misc/crush80,rgb-scheme.yaml
```yaml
description: Per-key backlight scheme for the Crush 80 (RGB build with the per-key engine)

compatible: "crush80,rgb-scheme"

include: base.yaml

properties:
  layer-modes:
    type: array
    required: true
    description: Per layer index. 0 = dark keys, 1 = light keys by what they do, 2 = ignore this layer (marker layers), 3 = ambient wave over the whole board while a USB host is connected, dark keys otherwise.
  layer-side:
    type: array
    required: true
    description: Per layer index, 0xRRGGBB colour of the side bar and logo (0 = dark).
  layer-side-win:
    type: array
    required: true
    description: Same, used while the Windows marker layer is active.
  group-colors:
    type: array
    required: true
    description: 0xRRGGBB per key group, in the order arrow, line, word, page, delete, clip, number, symbol, letter, macro, layer, mod, ctrl, fkey, media, desktop, system, danger.
  mod-combo-colors:
    type: array
    required: true
    description: 15 colours, 0xRRGGBB, for each combination of held modifiers, indexed by mask-1 where Ctrl is 1, Shift 2, Alt 4, Gui 8 (left or right alike). While any modifier is held the whole backlight is dark except the mod bar, which shows this colour.
  mod-bar:
    type: array
    required: true
    description: Matrix positions of the keys that form the mod bar (the top row, positions 0-15 on the Crush 80).
  ambient-colors:
    type: array
    required: false
    description: Two 0xRRGGBB colours the ambient wave (mode 3) runs between. Default cyan and pink.
  ambient-colors-win:
    type: array
    required: false
    description: Same, used while the Windows marker layer is active. Default azure and orchid.
  overrides:
    type: array
    required: true
    description: Triples of layer index, key position and 0xRRGGBB that win over the group colour. Use <255 0 0> for none.
```
